## components/board/Kconfig
```kconfig
menu "ESP32-S3-USB-OTG board"

choice GATEWAY_USB_HOST_POWER_SOURCE
    prompt "USB Type-A host VBUS source"
    default GATEWAY_USB_HOST_POWER_USB_DEV
    help
        The ESP32-S3-USB-OTG Type-A female HOST port is not powered from the
        Micro-USB debug/power connector. Select the actual host VBUS source.

config GATEWAY_USB_HOST_POWER_USB_DEV
    bool "USB_DEV 5 V input (recommended bench setup)"
    help
        Use 5 V supplied through the board's USB_DEV Type-A male connector.

config GATEWAY_USB_HOST_POWER_BATTERY
    bool "On-board battery boost converter"
    help
        Use an attached Li-ion battery and enable the board boost converter.

config GATEWAY_USB_HOST_POWER_OFF
    bool "Leave host VBUS disabled"
    help
        Use only when the downstream topology has been verified to work without
        upstream VBUS. Some self-powered hubs still require host VBUS for attach
        or session detection, so USB_DEV remains the safer default with a hub.

endchoice

endmenu
```

## components/display_service/Kconfig
```kconfig
menu "Gateway display"

config GATEWAY_DISPLAY_TIMEOUT_SECONDS
    int "Turn the display off after this many seconds without new content (0 = never)"
    range 0 3600
    default 60
    help
        The display wakes up whenever Wi-Fi, MQTT or modem state changes, an
        SMS arrives, or a front button is pressed.

config GATEWAY_DISPLAY_SETUP_TIMEOUT_SECONDS
    int "Display timeout while the setup portal is open (0 = never)"
    range 0 3600
    default 300

config GATEWAY_DISPLAY_SMS_PREVIEW
    bool "Show the beginning of the last received SMS"
    default y
    help
        Disable to show only the sender and time of the last SMS.

config GATEWAY_DISPLAY_PORTAL_HOLD_SECONDS
    int "Hold MENU this many seconds to open the setup portal"
    range 2 15
    default 5

endmenu
```

## components/modem_manager/Kconfig
```kconfig
menu "Modem manager"

config GATEWAY_MODEM_POLL_READY_MS
    int "Status poll interval while registered (ms)"
    range 5000 300000
    default 30000

config GATEWAY_MODEM_POLL_WAIT_MS
    int "Status poll interval while waiting for SIM/network (ms)"
    range 1000 60000
    default 5000

config GATEWAY_MODEM_FAILURES_BEFORE_RECOVERY
    int "Consecutive AT failures before recovery"
    range 2 10
    default 3

config GATEWAY_MODEM_HARD_RESET_AFTER_RECOVERIES
    int "Recovery rounds before VBUS hard reset"
    range 1 10
    default 2

config GATEWAY_MODEM_HARD_RESET_OFF_MS
    int "USB VBUS power-off duration during hard reset (ms)"
    range 500 10000
    default 1500

config GATEWAY_MODEM_RECOVERY_BACKOFF_MS
    int "Recovery backoff after modem reset (ms)"
    range 1000 60000
    default 5000

endmenu
```

## components/network_service/Kconfig
```kconfig
menu "Gateway Wi-Fi"

config GATEWAY_WIFI_PORTAL_FALLBACK_SECONDS
    int "Open the setup portal after this many seconds offline"
    range 30 3600
    default 180
    help
        When the saved Wi-Fi network cannot be reached for this long, the
        gateway additionally opens its setup access point. It keeps retrying
        the saved network in the background and closes the portal again as soon
        as the connection is back.

config GATEWAY_WIFI_MANUAL_PORTAL_SECONDS
    int "Close a manually opened setup portal after (seconds)"
    range 60 3600
    default 600

endmenu
```

## components/ota_service/Kconfig
```kconfig
menu "Gateway OTA"

config GATEWAY_OTA_CONFIRM_DELAY_SECONDS
    int "OTA boot confirmation delay (seconds)"
    default 30
    range 5 300
    help
        A newly booted OTA image remains pending verification until all critical
        services have initialized and this additional stability window has
        elapsed. Any reset before confirmation causes bootloader rollback.

endmenu
```

## components/usb_modem_transport/Kconfig
```kconfig
menu "USB modem transport"

config GATEWAY_MODEM_USB_VID
    hex "Target modem USB vendor ID"
    default 0x12D1
    help
        Huawei Technologies vendor ID for the initial supported modem family.

config GATEWAY_MODEM_USB_PID
    hex "Target modem USB product ID"
    default 0x1506
    help
        Post-mode-switch Huawei modem/network-card product ID.

config GATEWAY_MODEM_USB_SWITCH_PID_EXTRA
    hex "Additional Huawei pre-switch product ID (0 disables)"
    default 0x0000
    help
        In addition to the built-in Huawei 0x1446 and 0x14FE storage-mode
        personalities, optionally recognize one site-specific cold-boot PID.

config GATEWAY_MODEM_USB_PROBE_RETRIES
    int "AT probe retries per candidate interface"
    range 1 10
    default 3

config GATEWAY_MODEM_USB_PROBE_TIMEOUT_MS
    int "AT probe response timeout (ms)"
    range 250 10000
    default 2000

config GATEWAY_MODEM_USB_OPEN_TIMEOUT_MS
    int "CDC interface open timeout (ms)"
    range 0 10000
    default 1000

config GATEWAY_MODEM_USB_RX_BUFFER_SIZE
    int "CDC bulk IN buffer size"
    range 64 4096
    default 512

config GATEWAY_MODEM_USB_TX_BUFFER_SIZE
    int "CDC bulk OUT buffer size"
    range 64 4096
    default 512

endmenu
```
